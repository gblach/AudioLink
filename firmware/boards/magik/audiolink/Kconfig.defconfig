## firmware/boards/magik/audiolink/Kconfig.defconfig
```kconfig
if BOARD_AUDIOLINK_NRF5340_CPUAPP

config BT_HCI_IPC
	default y if BT_HCI

config HEAP_MEM_POOL_ADD_SIZE_BOARD
	int
	default 4096 if BT_HCI_IPC

endif # BOARD_AUDIOLINK_NRF5340_CPUAPP
```

## firmware/boards/magik/audiolink/board.yml
```yaml
board:
  name: audiolink
  full_name: AudioLink
  vendor: magik
  socs:
  - name: nrf5340
```
